//including libraries
#include <Keypad.h>
#include <esp_now.h>
#include <WiFi.h>
#include <Wire.h>
#include <Adafruit_GFX.h>
#include <Adafruit_SSD1306.h>

//matrix for displaying shortcuts in display
const char* textMatrix[3][12] = {
  {"copy", "autocolor", "curve", "fullscreen","paste", "razor", "timeline L", "timeline R","cut", "save", "undo", "redo"},
  {"copy", "group", "new", "export","paste", "node", "pen", "color","cut", "save", "undo", "redo"},
  {"copy", "autokey", "+keyframe", "-keyframe","paste", "cam", "render ani", "render fr","cut", "save", "undo", "redo"},
};

//screen
#define SCREEN_WIDTH 128
#define SCREEN_HEIGHT 32

Adafruit_SSD1306 display(SCREEN_WIDTH, SCREEN_HEIGHT, &Wire, -1);

//image shown when blender layer is active
const unsigned char blender [] PROGMEM = {
  0x00, 0x00, 0x00, 0x00, 0x00, 0x00, 0x00, 0x00, 0x00, 0x00, 0x00, 0x00, 0x00, 0x00, 0x00, 0x00, 
  0x00, 0x00, 0x00, 0x00, 0x00, 0x00, 0x00, 0x00, 0x00, 0x00, 0x00, 0x00, 0x00, 0x00, 0x00, 0x00, 
  0x00, 0x00, 0x00, 0x00, 0x00, 0x00, 0x00, 0x00, 0x00, 0x00, 0x00, 0x00, 0x00, 0x00, 0x00, 0x00, 
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  0x00, 0x00, 0x00, 0x00, 0x00, 0x00, 0x00, 0x00, 0x00, 0x00, 0x00, 0x00, 0x00, 0x00, 0x00, 0x00 
};
//image shown when davinci layer is active
const unsigned char davinci [] PROGMEM = {
  0x00, 0x00, 0x00, 0x00, 0x00, 0x00, 0x00, 0x00, 0x00, 0x00, 0x00, 0x00, 0x00, 0x00, 0x00, 0x00, 
  0x00, 0x00, 0x00, 0x00, 0x00, 0x00, 0x00, 0x00, 0x00, 0x00, 0x00, 0x00, 0x00, 0x00, 0x00, 0x00, 
  0x00, 0x00, 0x00, 0x00, 0x00, 0x00, 0x00, 0x00, 0x00, 0x00, 0x00, 0x00, 0x00, 0x00, 0x00, 0x00, 
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  0x00, 0x00, 0x00, 0x00, 0x00, 0x00, 0x00, 0x00, 0x00, 0x00, 0x00, 0x00, 0x00, 0x00, 0x00, 0x00
};
//image shown when affinity layer is active
const unsigned char affinity [] PROGMEM = {
  0x00, 0x00, 0x00, 0x00, 0x00, 0x00, 0x00, 0x00, 0x00, 0x00, 0x00, 0x00, 0x00, 0x00, 0x00, 0x00, 
  0x00, 0x00, 0x00, 0x00, 0x00, 0x00, 0x00, 0x00, 0x00, 0x00, 0x00, 0x00, 0x00, 0x00, 0x00, 0x00, 
  0x00, 0x00, 0x00, 0x00, 0x00, 0x00, 0x00, 0x00, 0x00, 0x00, 0x00, 0x00, 0x00, 0x00, 0x00, 0x00, 
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  0x00, 0x00, 0x00, 0x00, 0x00, 0x00, 0x00, 0x00, 0x00, 0x00, 0x00, 0x00, 0x00, 0x00, 0x00, 0x00
};

// Array of all bitmaps for convenience.
const int epd_bitmap_allArray_LEN = 3;
const unsigned char* epd_bitmap_allArray[3] = {
	davinci,
	affinity,
	blender
};

const int bitmapCount = sizeof(epd_bitmap_allArray) / sizeof(epd_bitmap_allArray[0]);

// Function to draw a bitmap
void drawBitmap(const unsigned char* epd_bitmap_allArray) {
  display.clearDisplay();
  display.drawBitmap(0, 0,epd_bitmap_allArray, SCREEN_WIDTH, SCREEN_HEIGHT, WHITE);
  display.display();
}

// THE RECEIVER'S MAC Address
uint8_t broadcastAddress[] = {0xd8, 0x3b, 0xda, 0xa4, 0xcc, 0xe8};

// Structure to send data
// Must match the receiver structure
typedef struct struct_message {
    int id; // Must be unique for each sender board
    int x;
    int y; // Toggle
} struct_message;

// Create a struct_message called myData
struct_message myData;

// Create peer interface
esp_now_peer_info_t peerInfo;

// Callback when data is sent
void OnDataSent(const uint8_t *mac_addr, esp_now_send_status_t status) {
  Serial.print("\r\nLast Packet Send Status:\t");
  Serial.println(status == ESP_NOW_SEND_SUCCESS ? "Delivery Success" : "Delivery Fail");
}

// Toggle for switching layers
#define BUTTON_PIN 17 // GPIO pin for the button
int buttonState = LOW;      // Current state of the button
int lastButtonState = LOW;  // Previous state of the button
int mode = 0;

// Debounce variables
const unsigned long debounceDelay = 0;  // Debounce time in milliseconds
unsigned long lastDebounceTime = 10;      // Last time the button state was changed

// Keypad (existing library for matrix of buttons used for convenience)
#define ROWS  4
#define COLS  3
//default from example for library
char keyMap[ROWS][COLS] = {
  {'D', '8', '4'},
  {'C', '7', '3'},
  {'B', '6', '2'},
  {'A', '5', '1'}
};
//defining pins for rows and cols
uint8_t rowPins[ROWS] = {36, 35, 41, 42};
uint8_t colPins[COLS] = {40, 39, 38};
 
Keypad keypad = Keypad(makeKeymap(keyMap), rowPins, colPins, ROWS, COLS);
//function for display
void displayTextWithImage(int x, int y) {
  display.clearDisplay();
  display.setTextSize(2);  // Adjust size if needed
  display.setTextColor(WHITE);
  display.setCursor(0, 10);
//Displaying used shortcut stored in matrix on screen
  if (x > 0 && y > 0 && y <= 3 && x <= 12) { // Ensure indices are valid
    display.println(textMatrix[y - 1][x - 1]); // Adjust for 0-based indexing
  } else {
    display.println("Invalid Data");
  }
  
  display.display();
}
//setup
void setup() {
  pinMode(BUTTON_PIN, INPUT_PULLUP);
  Serial.begin(115200);

    // Initialize I2C with custom SDA and SCL pins
  Wire.begin(20, 21);  // Set GPIO 20 as SDA and GPIO 21 as SCL
   // Initialize the display
  if (!display.begin(SSD1306_SWITCHCAPVCC, 0x3C)) {
    Serial.println("SSD1306 allocation failed");
    for (;;); // Halt execution if initialization fails
  }
  
  display.clearDisplay();
  display.display();
   int imageIndex = 1; // Change this to 0, 1, or 2 for different images
  if (imageIndex < bitmapCount) {
    drawBitmap(epd_bitmap_allArray[imageIndex]);
  } else {
    display.clearDisplay();
    display.setCursor(10, 15);
    display.setTextColor(WHITE);
    display.print("Invalid Index");
    display.display();
  }
 
  // Set device as a Wi-Fi Station
  WiFi.mode(WIFI_STA);
  
  // Init ESP-NOW
  if (esp_now_init() != ESP_OK) {
    Serial.println("Error initializing ESP-NOW");
    return;
  }
  
  // Register for Send Callback
  esp_now_register_send_cb(OnDataSent);
  
  // Register peer
  memcpy(peerInfo.peer_addr, broadcastAddress, 6);
  peerInfo.channel = 0;  
  peerInfo.encrypt = false;
  
  // Add peer
  if (esp_now_add_peer(&peerInfo) != ESP_OK) {
    Serial.println("Failed to add peer");
    return;
  }
}

// At the top with other global variables
int currentLayer = 1;  // Keep track of the current layer

// function for layer change
void checkButton() {
  int reading = digitalRead(BUTTON_PIN);

  // Check for button state change and debounce
  if (reading != lastButtonState) {
    lastDebounceTime = millis();  // Reset debounce timer
  }

  if ((millis() - lastDebounceTime) > debounceDelay) { // If debounce time has passed
    if (reading == LOW && buttonState == HIGH) {  // Button pressed
      int previousLayer = currentLayer; // Store the previous layer value
      currentLayer++;  // Increment layer
      if (currentLayer > bitmapCount) currentLayer = 1;  // Wrap around if exceeds bitmap count

      if (currentLayer != previousLayer) {  // Only proceed if the layer has changed
        // Debugging
        Serial.print("Button pressed! Layer changed to: ");
        Serial.println(currentLayer);

        // Update display with the corresponding bitmap
        int index = currentLayer - 1;  // Convert layer to 0-based index
        display.clearDisplay();  // Clear the screen
        display.drawBitmap(0, 0, epd_bitmap_allArray[index], SCREEN_WIDTH, SCREEN_HEIGHT, SSD1306_WHITE);
        display.display();

        // Update and send data
        myData.x = 0;
        myData.y = currentLayer;

        // Debug prints
        Serial.println(myData.x);
        Serial.println(myData.y);

        // Send message via ESP-NOW
        esp_err_t result = esp_now_send(broadcastAddress, (uint8_t *)&myData, sizeof(myData));
        if (result == ESP_OK) {
          Serial.println("Sent with success");
        } else {
          Serial.println("Error sending the data");
        }
      }
    }
    buttonState = reading;  // Update button state
  }

  lastButtonState = reading;  // Save last button state
}


//function for keys and displayed image
void checkKeypad() {
  if (keypad.getKeys()) {
    for (int i = 0; i < LIST_MAX; i++) {
      if (keypad.key[i].stateChanged && keypad.key[i].kstate == PRESSED) {
        char key = keypad.key[i].kchar;
        myData.id = 1;  
        myData.y = currentLayer;  // Send current layer with keypress

        // Convert keypad press to x value
        if (key == 'A') myData.x = 9;
        else if (key == 'B') myData.x = 10;
        else if (key == 'C') myData.x = 11;
        else if (key == 'D') myData.x = 12;
        else myData.x = key - '0';  // For single-digit keys

        displayTextWithImage(myData.x, myData.y);  // Display the text and image


        // Debug prints
        Serial.print("Key Pressed: ");
        Serial.println(myData.x);
        Serial.print("Current Layer: ");
        Serial.println(myData.y);

        // Send message via ESP-NOW
        esp_err_t result = esp_now_send(broadcastAddress, (uint8_t *) &myData, sizeof(myData));
        if (result == ESP_OK) {
          Serial.println("Sent with success");
        } else {
          Serial.println("Error sending the data");
        }

        // Add a short delay to display the text
        delay(300);  // 2 seconds

        // Restore the original bitmap for the current layer
        const unsigned char* image = epd_bitmap_allArray[currentLayer - 1];
        display.clearDisplay();  // Clear the display
        display.drawBitmap(0, 0, image, SCREEN_WIDTH, SCREEN_HEIGHT, WHITE);
        display.display();
      }
    }
  }
}


void loop() {
  checkButton();
  checkKeypad();
  delay(10); // Small delay
}

